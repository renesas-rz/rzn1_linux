## Documentation/devicetree/bindings/fb/db9000fb.txt
```
* Digital Blocks DB9000 LCD Controller

Required properties:
- compatible: Should be "digitalblocks,db9000-clcd".
- reg: Address and length of the register set for lcdif
- interrupts: Should contain lcdif interrupts
- display : phandle to display node (see below for details)
- clocks: Clock phandles to the pixel and bus (ahb) clocks.

Optional properties:
- backlight-pwm-clock : If using the DB9000 PWM output for a backlight, this
  specifies the PWM output clock required.
- blink-period-ms : If built with CONFIG_FB_DB9000_BLINK, this specifies the
  blink period in ms, see the config menu.
- bus-width : The width of the interface to the LCD panel that is actually
  used. This is only needed if the bits-per-pixel property is set to 16 or
  less, but the board connects to a 24-bit panel. In which case, the controller
  will shift the 16-bit data to the most significant bits of the panel. If the
  buffer is less than 16bpp, the controller will use a palette to effectively
  generate 16bpp data for the panel.

* display node

Required properties:
- bits-per-pixel : <1>, <2>, <4>, <8> for paletted RGB565, <16> for RGB565,
  <24> for packed RGB888, <32> for RGB888.

Required sub-node:
- display-timings : Refer to binding doc display-timing.txt for details.

Examples:

fb0: fb@RZN1_LCD_BASE {
	compatible = "digitalblocks,db9000-clcd";
	interrupts = <GIC_SPI RZN1_IRQ_LCD IRQ_TYPE_LEVEL_HIGH>;
	reg = <RZN1_LCD_BASE RZN1_LCD_SIZE>;
	clock-names = "pclk", "ahb";
	clocks = <&clk_slcd>, <&clk_ahb_lcd>;
	status = "okay";

	bits-per-pixel = <32>;
	display-timings {
		native-mode = <&timing0>;
		timing0: timing0 {
			clock-frequency = <8000000>;
			hactive = <320>;
			vactive = <240>;
			hback-porch = <68>;
			hfront-porch = <20>;
			vback-porch = <18>;
			vfront-porch = <4>;
			hsync-len = <2>;
			vsync-len = <2>;
			hsync-active = <0>;
			vsync-active = <0>;
			de-active = <1>;
		};
	};
};
```

## Documentation/devicetree/bindings/interrupt-controller/renesas,rzn1-mux.txt
```
* Renesas RZ/N1 GPIO Interrupt Multiplexer

On Renesas RZ/N1 devices, there are several GPIO Controllers each with a number
of interrupt outputs. All of the interrupts from the GPIO Controllers are passed
to the GPIO Interrupt Multiplexer, which selects a sub-set of the interrupts to
pass onto the system interrupt controller.

A single node in the device tree is used to describe the GPIO IRQ Muxer.

Required properties:
- compatible: SoC-specific compatible string "renesas,<soc-specific>-gpioirqmux"
  followed by "renesas,rzn1-gpioirqmux" as fallback. The SoC-specific compatible
  strings must be one of:
	"renesas,r9a06g032-gpioirqmux" for RZ/N1D
	"renesas,r9a06g033-gpioirqmux" for RZ/N1S
- reg: Base address and size of GPIO IRQ Muxer registers.
- interrupts: List of output interrupts.
- #interrupt-cells: Numder of cells in the input interrupt specifier, must be 1.
- #address-cells: Must be 0.
- interrupt-map-mask: must be 127.
- interrupt-map: Standard property detailing the maps between input irqs and the
  corresponding output irq. This consist of a list of:
	<input-irq-spec phandle-to-interrupt-controller output-irq-spec>
  The input-irq-spec is from 0 to 95, corresponding to the outputs of the GPIO
  Controllers.

Example:

	The following is an example for the RZ/N1D SoC.

	gpioirqmux: interrupt-controller@51000480 {
		compatible = "renesas,r9a06g032-gpioirqmux",
				"renesas,rzn1-gpioirqmux";
		reg = <0x51000480 0x20>;
		interrupts =
			<GIC_SPI 103 IRQ_TYPE_LEVEL_HIGH>,
			<GIC_SPI 104 IRQ_TYPE_LEVEL_HIGH>;

		#interrupt-cells = <1>;
		#address-cells = <0>;
		interrupt-map-mask = <0x3f>;
		interrupt-map =
			/* gpio2a 24, pin 146: ETH Port 1 IRQ */
			<88 &gic GIC_SPI 103 IRQ_TYPE_LEVEL_HIGH>,
			/* gpio2a 26, pin 148: TouchSCRN_IRQ */
			<90 &gic GIC_SPI 104 IRQ_TYPE_LEVEL_HIGH>;
	};

	gpio2: gpio@5000d000 {
		compatible = "snps,dw-apb-gpio";
		reg = <0x5000d000 0x80>;
		#address-cells = <1>;
		#size-cells = <0>;
		clock-names = "bus";
		clocks = <&sysctrl R9A06G032_HCLK_GPIO2>;

		gpio2a: gpio@0 {
			compatible = "snps,dw-apb-gpio-port";
			bank-name = "gpio2a";
			gpio-controller;
			#gpio-cells = <2>;
			snps,nr-gpios = <32>;
			reg = <0>;

			interrupt-controller;
			interrupt-parent = <&gpioirqmux>;
			interrupts =  < 64 65 66 67 68 69 70 71
					72 73 74 75 76 77 78 79
					80 81 82 83 84 85 86 87
					88 89 90 91 92 93 94 95 >;
			#interrupt-cells = <2>;
		};
	};
```

## Documentation/devicetree/bindings/interrupt-controller/renesas,rzn1-mux.yaml
```yaml
# SPDX-License-Identifier: (GPL-2.0-only OR BSD-2-Clause)
%YAML 1.2
---
$id: http://devicetree.org/schemas/interrupt-controller/renesas,rzn1-mux.yaml#
$schema: http://devicetree.org/meta-schemas/core.yaml#

title: Renesas RZ/N1 GPIO Interrupt Multiplexer

maintainers:
  - Gareth Wiliams <gareth.williams.jx@renesas.com>

description: |
  On Renesas RZ/N1 devices, there are several GPIO Controllers each with a number
  of interrupt outputs. All of the interrupts from the GPIO Controllers are passed
  to the GPIO Interrupt Multiplexer, which selects a sub-set of the interrupts to
  pass onto the system interrupt controller.
  A single node in the device tree is used to describe the GPIO IRQ Muxer.

properties:
  compatible:
    items:
      - enum:
          - renesas,r9a06g032-gpioirqmux # RZ/N1D
          - renesas,r9a06g033-gpioirqmux # RZ/N1S
      - const: renesas,rzn1-gpioirqmux   # Required fallback

  reg:
    maxItems: 1

  interrupts:
    maxItems: 8
    minItems: 1
    description: List of output interrupts.

  "#interrupt-cells":
    const: 1
    description: Number of cells in the input interrupt specifier, must be 1.

  '#address-cells':
    const: 0

  interrupt-controller: true

  interrupt-map-mask:
    const: 0x3f

  interrupt-map:
    maxItems: 8
    minItems: 1
    description: |
      The property detailing the maps between input irqs and the
      corresponding output irq. This consists of a list of
      <input-irq-spec phandle-to-interrupt-controller output-irq-spec>
      The input-irq-spec is from 0 to 95, corresponding to the outputs
      of the GPIO Controllers.

required:
  - compatible
  - reg
  - interrupts
  - '#interrupt-cells'
  - '#address-cells'
  - interrupt-map-mask
  - interrupt-map
  - interrupt-controller

additionalProperties: false

examples:
  - |
    #include <dt-bindings/interrupt-controller/arm-gic.h>
    gpioirqmux: interrupt-controller@51000480 {
        compatible = "renesas,r9a06g032-gpioirqmux",
                     "renesas,rzn1-gpioirqmux";
        reg = <0x51000480 0x20>;
        interrupts = <GIC_SPI 103 IRQ_TYPE_LEVEL_HIGH>,
                     <GIC_SPI 104 IRQ_TYPE_LEVEL_HIGH>;
        #interrupt-cells = <1>;
        #address-cells = <0>;
        interrupt-controller;
        interrupt-map-mask = <0x3f>;
        interrupt-map = <88 &gic GIC_SPI 103 IRQ_TYPE_LEVEL_HIGH>,
                        <90 &gic GIC_SPI 104 IRQ_TYPE_LEVEL_HIGH>;
    };
```

## Documentation/devicetree/bindings/mtd/renesas,rzn1-qspi.txt
```
* MTD QSPI driver for RZN1

This driver should contains subnodes that corresponds to the m25p80.txt format,
with a few optional options.

Required properties:
- #address-cells, #size-cells : Must be present if the device has sub-nodes
      representing flash devices on different CS lines.
- compatible : Should be "renesas,rzn1-qspi".
- reg-names : "qspi", "qspi-mapping" -- necessary to locate which address range
      is the register one, and which one is the memory map for the flash.
- clock-names : must be "flexway", "pclk"

Optional properties:
- renesas,rzn1-cs_mux[ = <0/1>];
	This specifies whether we want to use the discrete CS lines (default
	mode) to handle up to 4 NOR chips, or if we want to use the 'mux'
	mode that can handle up to 16 of them.
	Note that this property is optional (default to zero), and it will also
	default to '1' in the case any of the sub flashes specified below have
	a CS number >3
Furthermore, each sub node for each chip may contain (on top of the m25p80):
- spi-max-frequency: Same definition as spi-bus
- spi-rx-bus-width : Same definition as spi-bus
- spi-cpha : Same definition as spi-bus
- spi-cpol : Same definition as spi-bus

- renesas,rzn1-read-cmd [ = <COMMAND DUMMY ADDR_MUX>];
	Syntax is:
	    + COMMAND: Read Array opcode to use
	    + DUMMY: Number of dummy/mode cycles
	    + ADDR_MUX: 0/1: If the address sent to the NOR flash is sent on
			     multiple pins.
	The number of address bytes is optional, if not set here (or zero)
	the driver will rely on what the spi-nor framework decides to set it
	to. It's likely it will attempt to set the device forcibly in 4 bytes
	mode, which can be an issue at reset time (for the ROM and such) if
	the SPI NOR doesn't have a dedicated coupled reset line.
	IMPORTANT NOTE: Use of this property requires the SPI NOR flash to be
		marked as SPI_NOR_DUAL_READ and/or SPI_NOR_QUAD_READ in the
		spi-nor driver in drivers/mtd/spi-nor/spi-nor.c -- without this
		flag, the driver will fail to work.
- renesas,rzn1-readcap-delay = <N>;
	Specifies the read delay to use when talking to the flash at high speed
	The value can be probed using u-boot and should be constant for each
	type of flash, however board layout might have some impact.

Example:

spi@RZN1_QSPI_BASE {
	compatible = "renesas,rzn1-qspi";
	#address-cells = <1>;
	#size-cells = <0>;
	reg = <RZN1_QSPI_BASE RZN1_QSPI_SIZE
		RZN1_V_QSPI_BASE RZN1_V_QSPI_SIZE>;
	reg-names = "qspi", "qspi-mapping";
	interrupts = <GIC_SPI
		RZN1_IRQ_QSPI0 IRQ_TYPE_LEVEL_HIGH>;
	clocks = <&clk_fw_qspi0>, <&clk_qspi0>;
	clock-names = "flexway", "pclk";
	status = "okay";

	renesas,rzn1-cs_mux = <0>;

	flash: mx25l12805@0 {
		#address-cells = <1>;
		#size-cells = <1>;
		compatible = "st,mx25l12805d";
		reg = <0>;
		spi-max-frequency = <62500000>;
		spi-cpha;
		spi-cpol;

		/* Use 0x6b command to read data on 4 lines,
		   using 8 dummy cycles, and
		   the address is also sent on 4 lines.
		   Check your datasheet for the 'optimal' opcode to use;
		   the spi-nor upper layer defaults to slightly less
		   optimal opcodes */
		spi-rx-bus-width = <4>;
		renesas,rzn1-read-cmd = <0x6b 8 1>;

		renesas,rzn1-readcap-delay = <1>;

		partition@0 {
			/* 1MB */
			label = "loader";
			reg = <0x000000 0x00100000>;
		};
		partition@1 {
			/* 1MB */
			label = "u-boot";
			reg = <0x100000 0x00100000>;
		};
	};
```

## Documentation/devicetree/bindings/mtd/renesas,rzn1-qspi.yaml
```yaml
# SPDX-License-Identifier: GPL-2.0-only
%YAML 1.2
---
$id: http://devicetree.org/schemas/mtd/renesas,rzn1-qspi.yaml#
$schema: http://devicetree.org/meta-schemas/core.yaml#

title: MTD QSPI driver for RZ/N1

maintainers:
  - Gareth Williams <gareth.williams.jx@renesas.com>

description: |
  This driver should contains subnodes that corresponds to the
  jedec,spi-nor.yaml format, with a few optional options. Furthermore,
  each sub node for each chip may contain the following with the same
  definition as spi-bus -
  spi-max-frequency
  spi-rx-bus-width
  spi-cpha
  spi-cpol

  compatible:
    const: renesas,rzn1-qspi

properties:
  reg:
    minItems: 4
    maxItems: 4
  reg-names:
    description: |
      qspi for the controller registers, qspi-mapping for memory-mapped access
      to the flash device.
    items:
      - const: qspi
      - const: qspi-mapping

  clocks:
    minItems: 2
    maxItems: 4
  clock-names:
    items:
      - const: hclk
      - const: pclk

  renesas,rzn1-cs_mux:
    $ref: /schemas/types.yaml#/definitions/boolean
    description: |
      This specifies whether we want to use the discrete CS lines (default
      mode) to handle up to 4 NOR chips, or if we want to use the 'mux'
      mode that can handle up to 16 of them.
      Note that this property is optional (default to zero), and it will also
      default to '1' in the case any of the sub flashes specified below have
      a CS number >3.

  renesas,rzn1-read-cmd:
    $ref: /schemas/types.yaml#/definitions/uint32-array
    description: |
      Syntax is [<COMMAND DUMMY ADDR_MUX>]
      COMMAND -  Read Array opcode to use
      DUMMY - Number of dummy/mode cycles
      ADDR_MUX - 0/1 If the address sent to the NOR flash is sent on
      multiple pins.
      The number of address bytes is optional, if not set here (or zero)
      the driver will rely on what the spi-nor framework decides to set it
      to. It's likely it will attempt to set the device forcibly in 4 bytes
      mode, which can be an issue at reset time (for the ROM and such) if
      the SPI NOR doesn't have a dedicated coupled reset line.
      IMPORTANT NOTE Use of this property requires the SPI NOR flash to be
      marked as SPI_NOR_DUAL_READ and/or SPI_NOR_QUAD_READ in the
      spi-nor driver in drivers/mtd/spi-nor/spi-nor.c -- without this
      flag, the driver will fail to work.

  renesas,rzn1-readcap-delay:
    $ref: /schemas/types.yaml#/definitions/uint32
    description: |
      Specifies the read delay to use when talking to the flash at high speed
      The value can be probed using u-boot and should be constant for each
      type of flash, however board layout might have some impact.

required:
  - compatible
  - reg-names
  - clocks
  - clock-names

additionalProperties: false

examples:
  - |
    #include <dt-bindings/clock/r9a06g032-sysctrl.h>
    #include <dt-bindings/interrupt-controller/arm-gic.h>
    qspi: qspi0: spi@40005000 {
        compatible = "renesas,rzn1-qspi";
        #address-cells = <1>;
        #size-cells = <0>;
        reg = <0x40005000 0x1000
               0x10000000 0x10000000>;
        reg-names = "qspi", "qspi-mapping";
        interrupts = <GIC_SPI 64 IRQ_TYPE_LEVEL_HIGH>;
        clocks = <&sysctrl R9A06G032_HCLK_QSPI0>, <&sysctrl R9A06G032_CLK_QSPI0>;
        clock-names = "hclk", "pclk";
        status = "disabled";
    };
```

## Documentation/devicetree/bindings/net/morethanip,switch.yaml
```yaml
# SPDX-License-Identifier: (GPL-2.0-only OR BSD-2-Clause)
%YAML 1.2
---
$id: http://devicetree.org/schemas/net/morethanip,switch.yaml#
$schema: http://devicetree.org/meta-schemas/core.yaml#

title: MoreThanIP 5-port switch MDIO

maintainers:
  - Phil Edworthy <phil.edworthy@renesas.com>
  - Gareth Williams <gareth.williams.jx@renesas.com>

allOf:
  - $ref: ethernet-controller.yaml#

properties:
  compatible:
    const: mtip,5pt_switch

  reg:
    maxItems: 1

  clocks:
    items:
      - description: bus clk
      - description: peripheral clk

  clock-names:
    items:
      - const: hclk
      - const: pclk

  '#address-cells':
    description: Number of address cells for the MDIO bus.
    const: 1

  '#size-cells':
    description: Number of size cells on the MDIO bus.
    const: 0

required:
  - compatible
  - reg
  - clocks
  - clock-names
  - power-domains
  - '#address-cells'
  - '#size-cells'

additionalProperties: false

examples:
  - |
    #include <dt-bindings/clock/r9a06g032-sysctrl.h>

    switch: ethswitch: eth-switch@44050000 {
            compatible = "mtip,5pt_switch";
            reg = <0x44050000 0x10000>;
            clocks = <&sysctrl R9A06G032_HCLK_SWITCH>,
                     <&sysctrl R9A06G032_CLK_SWITCH>;
            clock-names = "hclk", "pclk";
            #address-cells = <1>;
            #size-cells = <0>;
    };
```
