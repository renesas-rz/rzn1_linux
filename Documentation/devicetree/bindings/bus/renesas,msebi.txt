## Documentation/devicetree/bindings/net/renesas,rzn1-miic.yaml
```yaml
# SPDX-License-Identifier: (GPL-2.0-only OR BSD-2-Clause)
%YAML 1.2
---
$id: http://devicetree.org/schemas/net/renesas,rzn1-miic.yaml#
$schema: http://devicetree.org/meta-schemas/core.yaml#

title: Renesas RZ/N1 RGMII/GMII Converter (MIIC)

maintainers:
  - Phil Edworthy <phil.edworthy@renesas.com>
  - Gareth Williams <gareth.williams.jx@renesas.com>

allOf:
  - $ref: ethernet-controller.yaml#

properties:
  compatible:
    const: renesas,rzn1-miic

  reg:
    maxItems: 1

  clocks:
    items:
      - description: mii ref clk
      - description: rmii ref clk
      - description: rgmii ref clk
      - description: switch bus clk

  clock-names:
    items:
      - const: mii_ref
      - const: rmii_ref
      - const: rgmii_ref
      - const: ahb

  power-domains:
    maxItems: 1

  '#address-cells':
    description: Number of address cells for the MDIO bus.
    const: 1

required:
  - compatible
  - reg
  - clocks
  - clock-names
  - power-domains
  - '#address-cells'

additionalProperties: false

examples:
  - |
    #include <dt-bindings/clock/r9a06g032-sysctrl.h>

    eth_miic: eth-miic@44030000 {
            compatible = "renesas,rzn1-miic";
            reg = <0x44030000 0x10000>;
            clocks = <&sysctrl R9A06G032_CLK_MII_REF>,
                     <&sysctrl R9A06G032_CLK_RMII_REF>,
                     <&sysctrl R9A06G032_CLK_RGMII_REF>,
                     <&sysctrl R9A06G032_HCLK_SWITCH>;
            clock-names = "mii_ref", "rmii_ref", "rgmii_ref", "ahb";
            power-domains = <&sysctrl>;
            #address-cells = <1>;
    };
```

## Documentation/devicetree/bindings/timer/renesas,rzn1-timer.txt
```
* Device tree bindings for Renesas RZ/N1 timer

This document provides bindings for the timer block in the RZ/N1 devices. The
timer block has 8 independent timers, each of which can be driven by an input
clock that can optionally be divided down by 25. Each timer generates it's own
interrupt.

Required Properties:
- compatible: should be "renesas,rzn1-timer" and one of the following.
 - "renesas,r9a06g032-timer": for RZ/N1D
 - "renesas,r9a06g033-timer": for RZ/N1S
- reg: base address and length of the registers for the timer block.
- interrupts : All 8 interrupts generated by the timer block.
- clocks : Must contain an entry for each entry in clock-names.
  See ../clocks/clock-bindings.txt for details.
- clocks: clock phandle and specifier pair.

Optional Properties:
- renesas,clk-prescaler: A list of boolean flags to enable the divide-by-25
  prescaler for each of the timers. Without this property, prescale is not used.
- renesas,timer-rating: A list of clock rating values for all timers. This can
  be used to ensure this timer has a higher or lower rating than other timers.

Example:

timer0: timer@51001000 {
	compatible = "renesas,r9a06g032-timer", "renesas,rzn1-timer";
	reg = <0x51001000 0x400>;
	interrupts = <GIC_SPI 112 IRQ_TYPE_LEVEL_HIGH>,
		     <GIC_SPI 113 IRQ_TYPE_LEVEL_HIGH>,
		     <GIC_SPI 114 IRQ_TYPE_LEVEL_HIGH>,
		     <GIC_SPI 115 IRQ_TYPE_LEVEL_HIGH>,
		     <GIC_SPI 116 IRQ_TYPE_LEVEL_HIGH>,
		     <GIC_SPI 117 IRQ_TYPE_LEVEL_HIGH>,
		     <GIC_SPI 118 IRQ_TYPE_LEVEL_HIGH>,
		     <GIC_SPI 119 IRQ_TYPE_LEVEL_HIGH>;
	clocks = <&hclk_timer0>;
	renesas,clk-prescaler = <1 1 1 1 1 1 0 0>;
	renesas,timer-rating = <150 150 150 150 150 150 460 460>;
};
```

## Documentation/devicetree/bindings/timer/renesas,rzn1-timer.yaml
```yaml
# SPDX-License-Identifier: (GPL-2.0-only OR BSD-2-Clause)
%YAML 1.2
---
$id: http://devicetree.org/schemas/timer/renesas,rzn1-timer.yaml#
$schema: http://devicetree.org/meta-schemas/core.yaml#

title: Renesas RZ/N1 Timer

maintainers:
  - Gareth Wiliams <gareth.williams.jx@renesas.com>

description:
  The timer block has 8 independent timers, each of which can be driven by an
  input clock that can optionally be divided down by 25. Each timer generates
  it's own interrupt.

properties:
  compatible:
    items:
      - enum:
        - "renesas,rzn1-timer"

  reg:
    maxItems: 1

  interrupts:
    maxItems: 8

  clocks:
    maxItems: 1

  renesas,clk-prescaler:
    $ref: /schemas/types.yaml#/definitions/uint32-array
    description: |
      A list of boolean flags to enable the divide-by-25
      prescaler for each of the timers. Without this property,
      prescale is not used.

  renesas,timer-rating:
    $ref: /schemas/types.yaml#/definitions/uint32-array
    description: |
      A list of clock rating values for all timers. This can
      be used to ensure this timer has a higher or lower rating
      than other timers.

required:
  - compatible
  - reg
  - interrupts
  - clocks

additionalProperties: false

examples:
  - |
    #include <dt-bindings/interrupt-controller/arm-gic.h>
    #include <dt-bindings/clock/r9a06g032-sysctrl.h>
    timer0: timer@51001000 {
            compatible = "renesas,rzn1-timer";
            reg = <0x51001000 0x400>;
            interrupts = <GIC_SPI 112 IRQ_TYPE_LEVEL_HIGH>,
                         <GIC_SPI 113 IRQ_TYPE_LEVEL_HIGH>,
                         <GIC_SPI 114 IRQ_TYPE_LEVEL_HIGH>,
                         <GIC_SPI 115 IRQ_TYPE_LEVEL_HIGH>,
                         <GIC_SPI 116 IRQ_TYPE_LEVEL_HIGH>,
                         <GIC_SPI 117 IRQ_TYPE_LEVEL_HIGH>,
                         <GIC_SPI 118 IRQ_TYPE_LEVEL_HIGH>,
                         <GIC_SPI 119 IRQ_TYPE_LEVEL_HIGH>;
            clocks = <&sysctrl R9A06G032_HCLK_TIMER0>;
            renesas,clk-prescaler = <1 1 1 1 1 1 0 0>;
            renesas,timer-rating = <150 150 150 150 150 150 460 460>;
    };
```

## Documentation/devicetree/bindings/usb/renesas,usbf.txt
```
Required properties :
 - compatible : Should be "renesas,usbf".
 - reg : Offset and length of the register set for the device.
 - clock-names: needs to be "axi".
 - clocks: must refer to the clock used by the IP.
 - interrupts: Should list the two interrupts needed by the IP

Optional Properties:
 - renesas,sram-conf[,<gadget-name>]
	This property allows you to specify the SRAM allocated per
	endpoint types, OR the SRAM allocated for each endpoint
	individually.
	In the first instance, if you specify a 3 element array, this
	specifies the number of USB packets per endpoint /type/, for
	example:
		renesas,sram-ep-packets = <4 3 0>;
	Will allocate 4 packets (of 512, implicitly) to the bulk
	endpoints (first element); 3 packets (or whatever size the
	descriptor specifies) to the interrupt endpoints, and the default
	value (which is 2, incidentally) of packets to the isochronous
	endpoints.
	In the second instance, you can specify the number of packets
	per endpoint by passing an array of more than 3 elements:
		renesas,sram-conf = <
			4 4 0 0 0	/* -bulk endpoints */
			4 0 0 0		/* -int endpoints */
			0 0 0 0 0 0>;	/* -iso endpoints */
	In this case, you can specify the size to the endpoints you
	know are being used.
	Note that you can tie a memory configuration for a particular
	gadget configuration; the driver will first look for the property
	name concatenated with the currently configured gadget before
	doing a fallback on the generic name. Thus:
		renesas,sram-conf,g_ether = <6 2 0>;
		renesas,sram-conf = <2 8 0>;
	This is a valid declaration providing a configuration for the
	RNDIS g_ether driver, and another configuration for any other
	cases/gadget.

 - renesas,sram-size
	The renesas IP can be configured with variable amount of SRAM,
	variable type/number of endpoints, and some of them disabled.
	The sram-size property is the only one that cannot be inferred
	by probing, so this properly allows you to specify it as per
	your device configuration.
	The SRAM size is just used to make sure you don't allocate too
	much using the renesas,sram-conf property, it can be left out,
	but doing so will prevent any warning from being emitted, and
	that could result in silent failure.
	NOTE: The ram size value is the number of 32 bits words in SRAM,
	      and NOT a byte value.
		renesas,sram-size = <5024>;

 - renesas,dma-threshold
	Specifies the packet size at below which we don't even attempt
	to do a DMA transfer. The DMA introduces some latency as the IRQ
	needs to be routed back to the driver, so a small packet size with DMA
	might take longer to transfer than sending it using plain PIO.
	The threshold is by default 64, however, it was not set using any
	measurement, so the value probably should be measured using proper
	empirical testing for the use you make of the driver.

Example:
	usbf: usbf@RZN1_USB_DEV_BASE {
		compatible = "renesas,usbf";
		reg = <RZN1_USB_DEV_BASE RZN1_USB_DEV_SIZE>;
		interrupts =
			<GIC_SPI
				RZN1_IRQ_USBF_EPC IRQ_TYPE_LEVEL_HIGH>,
			<GIC_SPI
				RZN1_IRQ_USBF IRQ_TYPE_LEVEL_HIGH>;
		clock-names = "axi";
		clocks = <&clk_fw_usb_f>;

		renesas,sram-size = <5024>; /* 32 bits words */
		renesas,sram-conf,g_ether = <6 6 0 0 0 4>;
		renesas,sram-conf,g_mass_storage = <8 8 0 0 0 0>;
		renesas,dma-threshold = <64>;
		status = "okay";
	};
```

## Documentation/devicetree/bindings/usb/renesas,usbf.yaml
```yaml
# SPDX-License-Identifier: (GPL-2.0-only OR BSD-2-Clause)
%YAML 1.2
---
$id: http://devicetree.org/schemas/usb/renesas,usbf.yaml#
$schema: http://devicetree.org/meta-schemas/core.yaml#

title: Renesas USB Function

maintainers:
  - Gareth Williams <gareth.williams.jx@renesas.com>

properties:
  compatible:
    const: renesas,usbf

  reg:
    maxItems: 1

  interrupts:
    maxItems: 2

  interrupt-names:
    items:
      - const: epc
      - const: usbf

  clocks:
    maxItems: 2

  clock-names:
    items:
      - const: axi
      - const: usbpm

  renesas,sram-conf:
      $ref: /schemas/types.yaml#/definitions/uint32-array
      description: |
          This property allows you to specify the SRAM allocated per
          endpoint types, OR the SRAM allocated for each endpoint
          individually. In the first instance, if you specify a 3 element
          array, this specifies the number of USB packets per endpoint
          /type/, for example -
              renesas,sram-ep-packets = <4 3 0>;
          will allocate 4 packets (of 512, implicitly) to the bulk endpoints
          (first element); 3 packets (or whatever size the descriptor
          specifies) to the interrupt endpoints, and the default value (2)
          of packets to the isochronous endpoints.
          In the second instance, you can specify the number of packets
          per endpoint by passing an array of more than 3 elements
              renesas,sram-conf = < 4 4 0 0 0     /* -bulk endpoints */
                                    4 0 0 0       /* -int endpoints  */
                                    0 0 0 0 0 0>; /* -iso endpoints  */
          In this case, you can specify the size to the endpoints you
          know are being used. Note that you can tie a memory configuration
          for a particular gadget configuration; the driver will first
          look for the property name concatenated with the currently
          configured gadget before doing a fallback on the generic name.
              renesas,sram-conf,g_ether = <6 2 0>;
              renesas,sram-conf = <2 8 0>;
          This is a valid declaration providing a configuration for the
          RNDIS g_ether driver, and another configuration for any other
          cases/gadget. The property may have the gadget-name appended
          in the format [,<gadget-name>].

  renesas,sram-size:
      $ref: /schemas/types.yaml#/definitions/uint32
      description: |
          The renesas IP can be configured with variable amount of SRAM,
          variable type/number of endpoints, and some of them disabled.
          The sram-size property is the only one that cannot be inferred
          by probing, so this properly allows you to specify it as per
          your device configuration.
          The SRAM size is just used to make sure you don't allocate too
          much using the renesas,sram-conf property, it can be left out,
          but doing so will prevent any warning from being emitted, and
          that could result in silent failure. The ram size value is the
          number of 32 bits words in SRAM, and NOT a byte value.

  renesas,dma-threshold:
      $ref: /schemas/types.yaml#/definitions/uint32
      description: |
          Specifies the packet size at below which we don't even attempt
          to do a DMA transfer. The DMA introduces some latency as the IRQ
          needs to be routed back to the driver, so a small packet size with DMA
          might take longer to transfer than sending it using plain PIO.
          The threshold is by default 64, however, it was not set using any
          measurement, so the value probably should be measured using proper
          empirical testing for the use you make of the driver.

required:
  - compatible
  - reg
  - interrupts
  - interrupt-names
  - clocks
  - clock-names

additionalProperties: false

examples:
  - |
    #include <dt-bindings/interrupt-controller/arm-gic.h>
    #include <dt-bindings/clock/r9a06g032-sysctrl.h>

    usbf: usbf@4001e000 {
        compatible = "renesas,rzn1-usbf";
        reg = <0x4001e000 0x2000>;
        interrupt-names = "epc", "usbf";
        interrupts = <GIC_SPI 77 IRQ_TYPE_LEVEL_HIGH>,
                     <GIC_SPI 78 IRQ_TYPE_LEVEL_HIGH>;
        clock-names = "axi", "usbpm";
        clocks = <&sysctrl R9A06G032_HCLK_USBF>,
                 <&sysctrl R9A06G032_HCLK_USBPM>;
        renesas,sram-size = <5024>;
        renesas,sram-conf,g_ether = <4 2 0>;
        renesas,sram-conf,g_mass_storage = <8 8 0 0 0 0>;
        status = "disabled";
    };
```
