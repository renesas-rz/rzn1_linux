/*
 * This file was autogenerated
 * DO NOT EDIT
 * (C) 2015-2016 Renesas Electronics Europe, LTD
 * All rights reserved.
 *
 * Redistribution and use in source and binary forms, with or without
 * modification, are permitted provided that the following conditions are met:
 *
 * 1. Redistributions of source code must retain the above copyright notice,
 * this list of conditions and the following disclaimer.
 *
 * 2. Redistributions in binary form must reproduce the above copyright notice,
 * this list of conditions and the following disclaimer in the documentation
 * and/or other materials provided with the distribution.
 *
 * THIS SOFTWARE IS PROVIDED BY THE COPYRIGHT HOLDERS AND CONTRIBUTORS "AS IS"
 * AND ANY EXPRESS OR IMPLIED WARRANTIES, INCLUDING, BUT NOT LIMITED TO, THE
 * IMPLIED WARRANTIES OF MERCHANTABILITY AND FITNESS FOR A PARTICULAR PURPOSE
 * ARE DISCLAIMED. IN NO EVENT SHALL THE COPYRIGHT HOLDER OR CONTRIBUTORS BE
 * LIABLE FOR ANY DIRECT, INDIRECT, INCIDENTAL, SPECIAL, EXEMPLARY, OR
 * CONSEQUENTIAL DAMAGES (INCLUDING, BUT NOT LIMITED TO, PROCUREMENT OF
 * SUBSTITUTE GOODS OR SERVICES; LOSS OF USE, DATA, OR PROFITS; OR BUSINESS
 * INTERRUPTION) HOWEVER CAUSED AND ON ANY THEORY OF LIABILITY, WHETHER IN
 * CONTRACT, STRICT LIABILITY, OR TORT (INCLUDING NEGLIGENCE OR OTHERWISE)
 * ARISING IN ANY WAY OUT OF THE USE OF THIS SOFTWARE, EVEN IF ADVISED OF THE
 * POSSIBILITY OF SUCH DAMAGE.
 */

&clocks {
	clk_25_pg4: clk_25_pg4@RZN1_CLK_25MHZ_PG4_ID {
		#clock-cells = <0>;
		compatible = "renesas,rzn1-clock-gate";
		reg = <RZN1_CLK_25MHZ_PG4_ID>;
		clocks = <&clkout_d40>;
	};
	clk_25_pg5: clk_25_pg5@RZN1_CLK_25MHZ_PG5_ID {
		#clock-cells = <0>;
		compatible = "renesas,rzn1-clock-gate";
		reg = <RZN1_CLK_25MHZ_PG5_ID>;
		clocks = <&clkout_d40>;
	};
	clk_25_pg6: clk_25_pg6@RZN1_CLK_25MHZ_PG6_ID {
		#clock-cells = <0>;
		compatible = "renesas,rzn1-clock-gate";
		reg = <RZN1_CLK_25MHZ_PG6_ID>;
		clocks = <&clkout_d40>;
	};
	clk_25_pg7: clk_25_pg7@RZN1_CLK_25MHZ_PG7_ID {
		#clock-cells = <0>;
		compatible = "renesas,rzn1-clock-gate";
		reg = <RZN1_CLK_25MHZ_PG7_ID>;
		clocks = <&clkout_d40>;
	};
	clk_25_pg8: clk_25_pg8@RZN1_CLK_25MHZ_PG8_ID {
		#clock-cells = <0>;
		compatible = "renesas,rzn1-clock-gate";
		reg = <RZN1_CLK_25MHZ_PG8_ID>;
		clocks = <&clkout_d40>;
	};
	clk_48_pg4: clk_48_pg4@RZN1_CLK_48MHZ_PG4_ID {
		#clock-cells = <0>;
		compatible = "renesas,rzn1-clock-gate";
		reg = <RZN1_CLK_48MHZ_PG4_ID>;
		clocks = <&clk_48>;
	};
	clk_48_pg_f: clk_48_pg_f@RZN1_CLK_48MHZ_PG_F_ID {
		#clock-cells = <0>;
		compatible = "renesas,rzn1-clock-gate";
		reg = <RZN1_CLK_48MHZ_PG_F_ID>;
		clocks = <&clk_48>;
	};
	clk_adc: clk_adc@RZN1_CLK_ADC_ID {
		#clock-cells = <0>;
		compatible = "renesas,rzn1-clock-gate";
		reg = <RZN1_CLK_ADC_ID>;
		clocks = <&div_adc>;
	};
	clk_cm3: clk_cm3@RZN1_CLK_CM3_ID {
		#clock-cells = <0>;
		compatible = "renesas,rzn1-clock-gate";
		reg = <RZN1_CLK_CM3_ID>;
		clocks = <&clk_ref_sync_d4>;
	};
	clk_ddrc: clk_ddrc@RZN1_CLK_DDRC_ID {
		#clock-cells = <0>;
		compatible = "renesas,rzn1-clock-gate";
		reg = <RZN1_CLK_DDRC_ID>;
		clocks = <&clk_ddrphy_pllclk_d4>;
	};
	clk_ddrphy_pllclk_d4: clk_ddrphy_pllclk_d4 {
		#clock-cells = <0>;
		compatible = "fixed-factor-clock";
		clock-div = <4>;
		clock-mult = <1>;
		clocks = <&clk_ddrphy_pllclk>;
	};
	clk_ecat100: clk_ecat100@RZN1_CLK_ECAT100_ID {
		#clock-cells = <0>;
		compatible = "renesas,rzn1-clock-gate";
		reg = <RZN1_CLK_ECAT100_ID>;
		clocks = <&clkout_d10>;
	};
	clk_ecat100_d4: clk_ecat100_d4 {
		#clock-cells = <0>;
		compatible = "fixed-factor-clock";
		clock-div = <4>;
		clock-mult = <1>;
		clocks = <&clk_ecat100>;
	};
	clk_ecat25: clk_ecat25@RZN1_CLK_ECAT25_ID {
		#clock-cells = <0>;
		compatible = "renesas,rzn1-clock-gate";
		reg = <RZN1_CLK_ECAT25_ID>;
		clocks = <&clk_ecat100_d4>;
	};
	clk_hsr100: clk_hsr100@RZN1_CLK_HSR100_ID {
		#clock-cells = <0>;
		compatible = "renesas,rzn1-clock-gate";
		reg = <RZN1_CLK_HSR100_ID>;
		clocks = <&clkout_d10>;
	};
	clk_hsr100_d2: clk_hsr100_d2 {
		#clock-cells = <0>;
		compatible = "fixed-factor-clock";
		clock-div = <2>;
		clock-mult = <1>;
		clocks = <&clk_hsr100>;
	};
	clk_hsr50: clk_hsr50@RZN1_CLK_HSR50_ID {
		#clock-cells = <0>;
		compatible = "renesas,rzn1-clock-gate";
		reg = <RZN1_CLK_HSR50_ID>;
		clocks = <&clk_hsr100_d2>;
	};
	clk_hw_rtos: clk_hw_rtos@RZN1_CLK_HW_RTOS_ID {
		#clock-cells = <0>;
		compatible = "renesas,rzn1-clock-gate";
		reg = <RZN1_CLK_HW_RTOS_ID>;
		clocks = <&clk_ref_sync_d4>;
	};
	clk_i2c0: clk_i2c0@RZN1_CLK_I2C0_ID {
		#clock-cells = <0>;
		compatible = "renesas,rzn1-clock-gate";
		reg = <RZN1_CLK_I2C0_ID>;
		clocks = <&div_i2c>;
	};
	clk_i2c1: clk_i2c1@RZN1_CLK_I2C1_ID {
		#clock-cells = <0>;
		compatible = "renesas,rzn1-clock-gate";
		reg = <RZN1_CLK_I2C1_ID>;
		clocks = <&div_i2c>;
	};
	clk_mii_ref: clk_mii_ref@RZN1_CLK_MII_REF_ID {
		#clock-cells = <0>;
		compatible = "renesas,rzn1-clock-gate";
		reg = <RZN1_CLK_MII_REF_ID>;
		clocks = <&clkout_d40>;
	};
	clk_nand: clk_nand@RZN1_CLK_NAND_ID {
		#clock-cells = <0>;
		compatible = "renesas,rzn1-clock-gate";
		reg = <RZN1_CLK_NAND_ID>;
		clocks = <&div_nand>;
	};
	clk_nousbp2_pg6: clk_nousbp2_pg6@RZN1_CLK_NOUSBP2_PG6_ID {
		#clock-cells = <0>;
		compatible = "renesas,rzn1-clock-gate";
		reg = <RZN1_CLK_NOUSBP2_PG6_ID>;
		clocks = <&div_p2_pg>;
	};
	clk_p1_pg2: clk_p1_pg2@RZN1_CLK_P1_PG2_ID {
		#clock-cells = <0>;
		compatible = "renesas,rzn1-clock-gate";
		reg = <RZN1_CLK_P1_PG2_ID>;
		clocks = <&div_p1_pg>;
	};
	clk_p1_pg3: clk_p1_pg3@RZN1_CLK_P1_PG3_ID {
		#clock-cells = <0>;
		compatible = "renesas,rzn1-clock-gate";
		reg = <RZN1_CLK_P1_PG3_ID>;
		clocks = <&div_p1_pg>;
	};
	clk_p1_pg4: clk_p1_pg4@RZN1_CLK_P1_PG4_ID {
		#clock-cells = <0>;
		compatible = "renesas,rzn1-clock-gate";
		reg = <RZN1_CLK_P1_PG4_ID>;
		clocks = <&div_p1_pg>;
	};
	clk_p4_pg3: clk_p4_pg3@RZN1_CLK_P4_PG3_ID {
		#clock-cells = <0>;
		compatible = "renesas,rzn1-clock-gate";
		reg = <RZN1_CLK_P4_PG3_ID>;
		clocks = <&div_p4_pg>;
	};
	clk_p4_pg4: clk_p4_pg4@RZN1_CLK_P4_PG4_ID {
		#clock-cells = <0>;
		compatible = "renesas,rzn1-clock-gate";
		reg = <RZN1_CLK_P4_PG4_ID>;
		clocks = <&div_p4_pg>;
	};
	clk_p6_pg1: clk_p6_pg1@RZN1_CLK_P6_PG1_ID {
		#clock-cells = <0>;
		compatible = "renesas,rzn1-clock-gate";
		reg = <RZN1_CLK_P6_PG1_ID>;
		clocks = <&div_p6_pg>;
	};
	clk_p6_pg2: clk_p6_pg2@RZN1_CLK_P6_PG2_ID {
		#clock-cells = <0>;
		compatible = "renesas,rzn1-clock-gate";
		reg = <RZN1_CLK_P6_PG2_ID>;
		clocks = <&div_p6_pg>;
	};
	clk_p6_pg3: clk_p6_pg3@RZN1_CLK_P6_PG3_ID {
		#clock-cells = <0>;
		compatible = "renesas,rzn1-clock-gate";
		reg = <RZN1_CLK_P6_PG3_ID>;
		clocks = <&div_p6_pg>;
	};
	clk_p6_pg4: clk_p6_pg4@RZN1_CLK_P6_PG4_ID {
		#clock-cells = <0>;
		compatible = "renesas,rzn1-clock-gate";
		reg = <RZN1_CLK_P6_PG4_ID>;
		clocks = <&div_p6_pg>;
	};
	clk_pci_usb: clk_pci_usb@RZN1_CLK_PCI_USB_ID {
		#clock-cells = <0>;
		compatible = "renesas,rzn1-clock-gate";
		reg = <RZN1_CLK_PCI_USB_ID>;
		clocks = <&clkout_d40>;
	};
	clk_48: clk_pll_usb: clk_pll_usb {
		#clock-cells = <0>;
		compatible = "fixed-clock";
		clock-frequency = <48000000>;
	};
	clk_qspi0: clk_qspi0@RZN1_CLK_QSPI0_ID {
		#clock-cells = <0>;
		compatible = "renesas,rzn1-clock-gate";
		reg = <RZN1_CLK_QSPI0_ID>;
		clocks = <&div_qspi0>;
	};
	clk_qspi1: clk_qspi1@RZN1_CLK_QSPI1_ID {
		#clock-cells = <0>;
		compatible = "renesas,rzn1-clock-gate";
		reg = <RZN1_CLK_QSPI1_ID>;
		clocks = <&div_qspi1>;
	};
	clk_ddrphy_pclk: clk_fw: clk_crypto: clk_ref_sync_d4: clk_ref_sync_d4 {
		#clock-cells = <0>;
		compatible = "fixed-factor-clock";
		clock-div = <4>;
		clock-mult = <1>;
		clocks = <&clk_ref_sync>;
	};
	clk_ref_sync_d8: clk_ref_sync_d8 {
		#clock-cells = <0>;
		compatible = "fixed-factor-clock";
		clock-div = <8>;
		clock-mult = <1>;
		clocks = <&clk_ref_sync>;
	};
	clk_rgmii_ref: clk_rgmii_ref@RZN1_CLK_RGMII_REF_ID {
		#clock-cells = <0>;
		compatible = "renesas,rzn1-clock-gate";
		reg = <RZN1_CLK_RGMII_REF_ID>;
		clocks = <&clkout_d8>;
	};
	clk_rmii_ref: clk_rmii_ref@RZN1_CLK_RMII_REF_ID {
		#clock-cells = <0>;
		compatible = "renesas,rzn1-clock-gate";
		reg = <RZN1_CLK_RMII_REF_ID>;
		clocks = <&clkout_d20>;
	};
	clk_sdio0: clk_sdio0@RZN1_CLK_SDIO0_ID {
		#clock-cells = <0>;
		compatible = "renesas,rzn1-clock-gate";
		reg = <RZN1_CLK_SDIO0_ID>;
		clocks = <&div_sdio0>;
	};
	clk_sdio1: clk_sdio1@RZN1_CLK_SDIO1_ID {
		#clock-cells = <0>;
		compatible = "renesas,rzn1-clock-gate";
		reg = <RZN1_CLK_SDIO1_ID>;
		clocks = <&div_sdio1>;
	};
	clk_sercos100: clk_sercos100@RZN1_CLK_SERCOS100_ID {
		#clock-cells = <0>;
		compatible = "renesas,rzn1-clock-gate";
		reg = <RZN1_CLK_SERCOS100_ID>;
		clocks = <&clkout_d10>;
	};
	clk_sercos100_d2: clk_sercos100_d2 {
		#clock-cells = <0>;
		compatible = "fixed-factor-clock";
		clock-div = <2>;
		clock-mult = <1>;
		clocks = <&clk_sercos100>;
	};
	clk_sercos50: clk_sercos50@RZN1_CLK_SERCOS50_ID {
		#clock-cells = <0>;
		compatible = "renesas,rzn1-clock-gate";
		reg = <RZN1_CLK_SERCOS50_ID>;
		clocks = <&clk_sercos100_d2>;
	};
	clk_slcd: clk_slcd@RZN1_CLK_SLCD_ID {
		#clock-cells = <0>;
		compatible = "renesas,rzn1-clock-gate";
		reg = <RZN1_CLK_SLCD_ID>;
		clocks = <&div_p1_pg>;
	};
	clk_spi0: clk_spi0@RZN1_CLK_SPI0_ID {
		#clock-cells = <0>;
		compatible = "renesas,rzn1-clock-gate";
		reg = <RZN1_CLK_SPI0_ID>;
		clocks = <&div_p3_pg>;
	};
	clk_spi1: clk_spi1@RZN1_CLK_SPI1_ID {
		#clock-cells = <0>;
		compatible = "renesas,rzn1-clock-gate";
		reg = <RZN1_CLK_SPI1_ID>;
		clocks = <&div_p3_pg>;
	};
	clk_spi2: clk_spi2@RZN1_CLK_SPI2_ID {
		#clock-cells = <0>;
		compatible = "renesas,rzn1-clock-gate";
		reg = <RZN1_CLK_SPI2_ID>;
		clocks = <&div_p3_pg>;
	};
	clk_spi3: clk_spi3@RZN1_CLK_SPI3_ID {
		#clock-cells = <0>;
		compatible = "renesas,rzn1-clock-gate";
		reg = <RZN1_CLK_SPI3_ID>;
		clocks = <&div_p3_pg>;
	};
	clk_spi4: clk_spi4@RZN1_CLK_SPI4_ID {
		#clock-cells = <0>;
		compatible = "renesas,rzn1-clock-gate";
		reg = <RZN1_CLK_SPI4_ID>;
		clocks = <&div_p4_pg>;
	};
	clk_spi5: clk_spi5@RZN1_CLK_SPI5_ID {
		#clock-cells = <0>;
		compatible = "renesas,rzn1-clock-gate";
		reg = <RZN1_CLK_SPI5_ID>;
		clocks = <&div_p4_pg>;
	};
	clk_switch: clk_switch@RZN1_CLK_SWITCH_ID {
		#clock-cells = <0>;
		compatible = "renesas,rzn1-clock-gate";
		reg = <RZN1_CLK_SWITCH_ID>;
		clocks = <&div_switch>;
	};
	clkout: clkout {
		#clock-cells = <0>;
		compatible = "fixed-clock";
		clock-frequency = <1000000000>;
	};
	clkout_d10: clkout_d10 {
		#clock-cells = <0>;
		compatible = "fixed-factor-clock";
		clock-div = <10>;
		clock-mult = <1>;
		clocks = <&clkout>;
	};
	msebis_clk: msebim_clk: clkout_d16: clkout_d16 {
		#clock-cells = <0>;
		compatible = "fixed-factor-clock";
		clock-div = <16>;
		clock-mult = <1>;
		clocks = <&clkout>;
	};
	clkout_d160: clkout_d160 {
		#clock-cells = <0>;
		compatible = "fixed-factor-clock";
		clock-div = <160>;
		clock-mult = <1>;
		clocks = <&clkout>;
	};
	clk_ddrphy_pllclk: clkout_d1or2: clkout_d1or2 {
		#clock-cells = <0>;
		compatible = "renesas,rzn1-clock-divider";
		renesas,rzn1-bit-mask = <0x3>;
		renesas,rzn1-div-min = <1>;
		renesas,rzn1-div-max = <2>;
		clocks = <&clkout>;
	};
	clk50: clkout_d20: clkout_d20 {
		#clock-cells = <0>;
		compatible = "fixed-factor-clock";
		clock-div = <20>;
		clock-mult = <1>;
		clocks = <&clkout>;
	};
	clk25: clkout_d40: clkout_d40 {
		#clock-cells = <0>;
		compatible = "fixed-factor-clock";
		clock-div = <40>;
		clock-mult = <1>;
		clocks = <&clkout>;
	};
	clkout_d5: clkout_d5 {
		#clock-cells = <0>;
		compatible = "fixed-factor-clock";
		clock-div = <5>;
		clock-mult = <1>;
		clocks = <&clkout>;
	};
	clk125: clkout_d8: clkout_d8 {
		#clock-cells = <0>;
		compatible = "fixed-factor-clock";
		clock-div = <8>;
		clock-mult = <1>;
		clocks = <&clkout>;
	};
	div_adc: div_adc@RZN1_SYSCTRL_REG_PWRCTRL_PG0_ADCDIV {
		#clock-cells = <0>;
		compatible = "renesas,rzn1-clock-divider";
		renesas,rzn1-bit-mask = <0xff>;
		renesas,rzn1-div-min = <50>;
		renesas,rzn1-div-max = <250>;
		reg = <RZN1_SYSCTRL_REG_PWRCTRL_PG0_ADCDIV>;
		clocks = <&clkout>;
	};
	clk_a7mp: div_ca7: div_ca7@RZN1_SYSCTRL_REG_PWRCTRL_CA7DIV {
		#clock-cells = <0>;
		compatible = "renesas,rzn1-clock-divider";
		renesas,rzn1-bit-mask = <0x7>;
		renesas,rzn1-div-min = <1>;
		renesas,rzn1-div-max = <4>;
		reg = <RZN1_SYSCTRL_REG_PWRCTRL_CA7DIV>;
		renesas,rzn1-div-table = <1 2 4>;
		clocks = <&clk_ref_sync>;
	};
	div_i2c: div_i2c@RZN1_SYSCTRL_REG_PWRCTRL_PG0_I2CDIV {
		#clock-cells = <0>;
		compatible = "renesas,rzn1-clock-divider";
		renesas,rzn1-bit-mask = <0x1f>;
		renesas,rzn1-div-min = <12>;
		renesas,rzn1-div-max = <16>;
		reg = <RZN1_SYSCTRL_REG_PWRCTRL_PG0_I2CDIV>;
		clocks = <&clkout>;
	};
	div_motor: div_motor@RZN1_SYSCTRL_REG_PWRCTRL_PG0_MOTORDIV {
		#clock-cells = <0>;
		compatible = "renesas,rzn1-clock-divider";
		renesas,rzn1-bit-mask = <0xf>;
		renesas,rzn1-div-min = <2>;
		renesas,rzn1-div-max = <8>;
		reg = <RZN1_SYSCTRL_REG_PWRCTRL_PG0_MOTORDIV>;
		clocks = <&clkout_d5>;
	};
	div_nand: div_nand@RZN1_SYSCTRL_REG_PWRCTRL_NFLASHDIV {
		#clock-cells = <0>;
		compatible = "renesas,rzn1-clock-divider";
		renesas,rzn1-bit-mask = <0x3f>;
		renesas,rzn1-div-min = <12>;
		renesas,rzn1-div-max = <32>;
		reg = <RZN1_SYSCTRL_REG_PWRCTRL_NFLASHDIV>;
		clocks = <&clkout>;
	};
	div_p1_pg: div_p1_pg@RZN1_SYSCTRL_REG_PWRCTRL_PG4_PR1DIV {
		#clock-cells = <0>;
		compatible = "renesas,rzn1-clock-divider";
		renesas,rzn1-bit-mask = <0xff>;
		renesas,rzn1-div-min = <12>;
		renesas,rzn1-div-max = <200>;
		reg = <RZN1_SYSCTRL_REG_PWRCTRL_PG4_PR1DIV>;
		clocks = <&clkout>;
	};
	div_p2_pg: div_p2_pg@RZN1_SYSCTRL_REG_PWRCTRL_PG1_PR2DIV {
		#clock-cells = <0>;
		compatible = "renesas,rzn1-clock-divider";
		renesas,rzn1-bit-mask = <0xff>;
		renesas,rzn1-div-min = <12>;
		renesas,rzn1-div-max = <128>;
		reg = <RZN1_SYSCTRL_REG_PWRCTRL_PG1_PR2DIV>;
		clocks = <&clkout>;
	};
	div_p3_pg: div_p3_pg@RZN1_SYSCTRL_REG_PWRCTRL_PG1_PR3DIV {
		#clock-cells = <0>;
		compatible = "renesas,rzn1-clock-divider";
		renesas,rzn1-bit-mask = <0xff>;
		renesas,rzn1-div-min = <8>;
		renesas,rzn1-div-max = <128>;
		reg = <RZN1_SYSCTRL_REG_PWRCTRL_PG1_PR3DIV>;
		clocks = <&clkout>;
	};
	div_p4_pg: div_p4_pg@RZN1_SYSCTRL_REG_PWRCTRL_PG1_PR4DIV {
		#clock-cells = <0>;
		compatible = "renesas,rzn1-clock-divider";
		renesas,rzn1-bit-mask = <0xff>;
		renesas,rzn1-div-min = <8>;
		renesas,rzn1-div-max = <128>;
		reg = <RZN1_SYSCTRL_REG_PWRCTRL_PG1_PR4DIV>;
		clocks = <&clkout>;
	};
	clk_p5_pg1: div_p5_pg: div_p5_pg@RZN1_SYSCTRL_REG_PWRCTRL_PG5_PR5DIV {
		#clock-cells = <0>;
		compatible = "renesas,rzn1-clock-divider";
		renesas,rzn1-bit-mask = <0x3f>;
		renesas,rzn1-div-min = <10>;
		renesas,rzn1-div-max = <40>;
		reg = <RZN1_SYSCTRL_REG_PWRCTRL_PG5_PR5DIV>;
		clocks = <&clkout>;
	};
	div_p6_pg: div_p6_pg@RZN1_SYSCTRL_REG_PWRCTRL_PGEXT2_PR6DIV {
		#clock-cells = <0>;
		compatible = "renesas,rzn1-clock-divider";
		renesas,rzn1-bit-mask = <0x7f>;
		renesas,rzn1-div-min = <12>;
		renesas,rzn1-div-max = <64>;
		reg = <RZN1_SYSCTRL_REG_PWRCTRL_PGEXT2_PR6DIV>;
		clocks = <&clkout>;
	};
	div_qspi0: div_qspi0@RZN1_SYSCTRL_REG_PWRCTRL_QSPI0DIV {
		#clock-cells = <0>;
		compatible = "renesas,rzn1-clock-divider";
		renesas,rzn1-bit-mask = <0x7>;
		renesas,rzn1-div-min = <3>;
		renesas,rzn1-div-max = <7>;
		reg = <RZN1_SYSCTRL_REG_PWRCTRL_QSPI0DIV>;
		clocks = <&clkout>;
	};
	div_qspi1: div_qspi1@RZN1_SYSCTRL_REG_PWRCTRL_QSPI1DIV {
		#clock-cells = <0>;
		compatible = "renesas,rzn1-clock-divider";
		renesas,rzn1-bit-mask = <0x7>;
		renesas,rzn1-div-min = <3>;
		renesas,rzn1-div-max = <7>;
		reg = <RZN1_SYSCTRL_REG_PWRCTRL_QSPI1DIV>;
		clocks = <&clkout>;
	};
	clk_ref_sync: div_ref_sync: div_ref_sync@RZN1_SYSCTRL_REG_PWRCTRL_OPPDIV {
		#clock-cells = <0>;
		compatible = "renesas,rzn1-clock-divider";
		renesas,rzn1-bit-mask = <0x1f>;
		renesas,rzn1-div-min = <2>;
		renesas,rzn1-div-max = <16>;
		reg = <RZN1_SYSCTRL_REG_PWRCTRL_OPPDIV>;
		renesas,rzn1-div-table = <2 4 8 16>;
		clocks = <&clkout>;
	};
	div_sdio0: div_sdio0@RZN1_SYSCTRL_REG_PWRCTRL_SDIO0DIV {
		#clock-cells = <0>;
		compatible = "renesas,rzn1-clock-divider";
		renesas,rzn1-bit-mask = <0xff>;
		renesas,rzn1-div-min = <20>;
		renesas,rzn1-div-max = <128>;
		reg = <RZN1_SYSCTRL_REG_PWRCTRL_SDIO0DIV>;
		clocks = <&clkout>;
	};
	div_sdio1: div_sdio1@RZN1_SYSCTRL_REG_PWRCTRL_SDIO1DIV {
		#clock-cells = <0>;
		compatible = "renesas,rzn1-clock-divider";
		renesas,rzn1-bit-mask = <0xff>;
		renesas,rzn1-div-min = <20>;
		renesas,rzn1-div-max = <128>;
		reg = <RZN1_SYSCTRL_REG_PWRCTRL_SDIO1DIV>;
		clocks = <&clkout>;
	};
	div_switch: div_switch@RZN1_SYSCTRL_REG_PWRCTRL_SWITCHDIV {
		#clock-cells = <0>;
		compatible = "renesas,rzn1-clock-divider";
		renesas,rzn1-bit-mask = <0x3f>;
		renesas,rzn1-div-min = <5>;
		renesas,rzn1-div-max = <40>;
		reg = <RZN1_SYSCTRL_REG_PWRCTRL_SWITCHDIV>;
		clocks = <&clkout>;
	};
	div_uart: div_uart@RZN1_SYSCTRL_REG_PWRCTRL_PG0_UARTDIV {
		#clock-cells = <0>;
		compatible = "renesas,rzn1-clock-divider";
		renesas,rzn1-bit-mask = <0xff>;
		renesas,rzn1-div-min = <12>;
		renesas,rzn1-div-max = <128>;
		reg = <RZN1_SYSCTRL_REG_PWRCTRL_PG0_UARTDIV>;
		clocks = <&clkout>;
	};
	hclk_adc: hclk_adc@RZN1_HCLK_ADC_ID {
		#clock-cells = <0>;
		compatible = "renesas,rzn1-clock-gate";
		reg = <RZN1_HCLK_ADC_ID>;
		clocks = <&clk_ref_sync_d8>;
	};
	hclk_can0: hclk_can0@RZN1_HCLK_CAN0_ID {
		#clock-cells = <0>;
		compatible = "renesas,rzn1-clock-gate";
		reg = <RZN1_HCLK_CAN0_ID>;
		clocks = <&clk_48>;
	};
	hclk_can1: hclk_can1@RZN1_HCLK_CAN1_ID {
		#clock-cells = <0>;
		compatible = "renesas,rzn1-clock-gate";
		reg = <RZN1_HCLK_CAN1_ID>;
		clocks = <&clk_48>;
	};
	hclk_cm3: hclk_cm3@RZN1_HCLK_CM3_ID {
		#clock-cells = <0>;
		compatible = "renesas,rzn1-clock-gate";
		reg = <RZN1_HCLK_CM3_ID>;
		clocks = <&clk_ref_sync_d4>;
	};
	hclk_crypto_eip150: hclk_crypto_eip150@RZN1_HCLK_CRYPTO_EIP150_ID {
		#clock-cells = <0>;
		compatible = "renesas,rzn1-clock-gate";
		reg = <RZN1_HCLK_CRYPTO_EIP150_ID>;
		clocks = <&clk_ref_sync_d4>;
	};
	hclk_crypto_eip93: hclk_crypto_eip93@RZN1_HCLK_CRYPTO_EIP93_ID {
		#clock-cells = <0>;
		compatible = "renesas,rzn1-clock-gate";
		reg = <RZN1_HCLK_CRYPTO_EIP93_ID>;
		clocks = <&clk_ref_sync_d4>;
	};
	hclk_ddrc: hclk_ddrc@RZN1_HCLK_DDRC_ID {
		#clock-cells = <0>;
		compatible = "renesas,rzn1-clock-gate";
		reg = <RZN1_HCLK_DDRC_ID>;
		clocks = <&clk_ref_sync_d4>;
	};
	hclk_deltasigma: hclk_deltasigma@RZN1_HCLK_DELTASIGMA_ID {
		#clock-cells = <0>;
		compatible = "renesas,rzn1-clock-gate";
		reg = <RZN1_HCLK_DELTASIGMA_ID>;
		clocks = <&div_motor>;
	};
	hclk_dma0: hclk_dma0@RZN1_HCLK_DMA0_ID {
		#clock-cells = <0>;
		compatible = "renesas,rzn1-clock-gate";
		reg = <RZN1_HCLK_DMA0_ID>;
		clocks = <&clk_ref_sync_d4>;
	};
	hclk_dma1: hclk_dma1@RZN1_HCLK_DMA1_ID {
		#clock-cells = <0>;
		compatible = "renesas,rzn1-clock-gate";
		reg = <RZN1_HCLK_DMA1_ID>;
		clocks = <&clk_ref_sync_d4>;
	};
	hclk_ecat125: hclk_ecat125@RZN1_HCLK_ECAT125_ID {
		#clock-cells = <0>;
		compatible = "renesas,rzn1-clock-gate";
		reg = <RZN1_HCLK_ECAT125_ID>;
		clocks = <&clkout_d8>;
	};
	hclk_gmac0: hclk_gmac0@RZN1_HCLK_GMAC0_ID {
		#clock-cells = <0>;
		compatible = "renesas,rzn1-clock-gate";
		reg = <RZN1_HCLK_GMAC0_ID>;
		clocks = <&clk_ref_sync_d4>;
	};
	hclk_gmac1: hclk_gmac1@RZN1_HCLK_GMAC1_ID {
		#clock-cells = <0>;
		compatible = "renesas,rzn1-clock-gate";
		reg = <RZN1_HCLK_GMAC1_ID>;
		clocks = <&clk_ref_sync_d4>;
	};
	hclk_gpio0: hclk_gpio0@RZN1_HCLK_GPIO0_ID {
		#clock-cells = <0>;
		compatible = "renesas,rzn1-clock-gate";
		reg = <RZN1_HCLK_GPIO0_ID>;
		clocks = <&clk_ref_sync_d4>;
	};
	hclk_gpio1: hclk_gpio1@RZN1_HCLK_GPIO1_ID {
		#clock-cells = <0>;
		compatible = "renesas,rzn1-clock-gate";
		reg = <RZN1_HCLK_GPIO1_ID>;
		clocks = <&clk_ref_sync_d4>;
	};
	hclk_gpio2: hclk_gpio2@RZN1_HCLK_GPIO2_ID {
		#clock-cells = <0>;
		compatible = "renesas,rzn1-clock-gate";
		reg = <RZN1_HCLK_GPIO2_ID>;
		clocks = <&clk_ref_sync_d4>;
	};
	hclk_hsr: hclk_hsr@RZN1_HCLK_HSR_ID {
		#clock-cells = <0>;
		compatible = "renesas,rzn1-clock-gate";
		reg = <RZN1_HCLK_HSR_ID>;
		clocks = <&clk_hsr100_d2>;
	};
	hclk_i2c0: hclk_i2c0@RZN1_HCLK_I2C0_ID {
		#clock-cells = <0>;
		compatible = "renesas,rzn1-clock-gate";
		reg = <RZN1_HCLK_I2C0_ID>;
		clocks = <&clk_ref_sync_d8>;
	};
	hclk_i2c1: hclk_i2c1@RZN1_HCLK_I2C1_ID {
		#clock-cells = <0>;
		compatible = "renesas,rzn1-clock-gate";
		reg = <RZN1_HCLK_I2C1_ID>;
		clocks = <&clk_ref_sync_d8>;
	};
	hclk_lcd: hclk_lcd@RZN1_HCLK_LCD_ID {
		#clock-cells = <0>;
		compatible = "renesas,rzn1-clock-gate";
		reg = <RZN1_HCLK_LCD_ID>;
		clocks = <&clk_ref_sync_d4>;
	};
	hclk_msebi_m: hclk_msebi_m@RZN1_HCLK_MSEBI_M_ID {
		#clock-cells = <0>;
		compatible = "renesas,rzn1-clock-gate";
		reg = <RZN1_HCLK_MSEBI_M_ID>;
		clocks = <&clk_ref_sync_d4>;
	};
	hclk_msebi_s: hclk_msebi_s@RZN1_HCLK_MSEBI_S_ID {
		#clock-cells = <0>;
		compatible = "renesas,rzn1-clock-gate";
		reg = <RZN1_HCLK_MSEBI_S_ID>;
		clocks = <&clk_ref_sync_d4>;
	};
	hclk_nand: hclk_nand@RZN1_HCLK_NAND_ID {
		#clock-cells = <0>;
		compatible = "renesas,rzn1-clock-gate";
		reg = <RZN1_HCLK_NAND_ID>;
		clocks = <&clk_ref_sync_d4>;
	};
	hclk_pg19: hclk_pg19@RZN1_HCLK_PG19_ID {
		#clock-cells = <0>;
		compatible = "renesas,rzn1-clock-gate";
		reg = <RZN1_HCLK_PG19_ID>;
		clocks = <&clk_ref_sync_d4>;
	};
	hclk_pg20: hclk_pg20@RZN1_HCLK_PG20_ID {
		#clock-cells = <0>;
		compatible = "renesas,rzn1-clock-gate";
		reg = <RZN1_HCLK_PG20_ID>;
		clocks = <&clk_ref_sync_d4>;
	};
	hclk_pg3: hclk_pg3@RZN1_HCLK_PG3_ID {
		#clock-cells = <0>;
		compatible = "renesas,rzn1-clock-gate";
		reg = <RZN1_HCLK_PG3_ID>;
		clocks = <&clk_ref_sync_d4>;
	};
	hclk_pg4: hclk_pg4@RZN1_HCLK_PG4_ID {
		#clock-cells = <0>;
		compatible = "renesas,rzn1-clock-gate";
		reg = <RZN1_HCLK_PG4_ID>;
		clocks = <&clk_ref_sync_d4>;
	};
	hclk_pg_i: hclk_pg_i@RZN1_HCLK_PG_I_ID {
		#clock-cells = <0>;
		compatible = "renesas,rzn1-clock-gate";
		reg = <RZN1_HCLK_PG_I_ID>;
		clocks = <&clk_ref_sync_d4>;
	};
	hclk_pinconfig: hclk_pinconfig@RZN1_HCLK_PINCONFIG_ID {
		#clock-cells = <0>;
		compatible = "renesas,rzn1-clock-gate";
		reg = <RZN1_HCLK_PINCONFIG_ID>;
		clocks = <&clkout_d40>;
	};
	hclk_pwmpto: hclk_pwmpto@RZN1_HCLK_PWMPTO_ID {
		#clock-cells = <0>;
		compatible = "renesas,rzn1-clock-gate";
		reg = <RZN1_HCLK_PWMPTO_ID>;
		clocks = <&div_motor>;
	};
	hclk_qspi0: hclk_qspi0@RZN1_HCLK_QSPI0_ID {
		#clock-cells = <0>;
		compatible = "renesas,rzn1-clock-gate";
		reg = <RZN1_HCLK_QSPI0_ID>;
		clocks = <&clk_ref_sync_d4>;
	};
	hclk_qspi1: hclk_qspi1@RZN1_HCLK_QSPI1_ID {
		#clock-cells = <0>;
		compatible = "renesas,rzn1-clock-gate";
		reg = <RZN1_HCLK_QSPI1_ID>;
		clocks = <&clk_ref_sync_d4>;
	};
	hclk_rom: hclk_rom@RZN1_HCLK_ROM_ID {
		#clock-cells = <0>;
		compatible = "renesas,rzn1-clock-gate";
		reg = <RZN1_HCLK_ROM_ID>;
		clocks = <&clk_ref_sync_d4>;
	};
	hclk_rsv: hclk_rsv@RZN1_HCLK_RSV_ID {
		#clock-cells = <0>;
		compatible = "renesas,rzn1-clock-gate";
		reg = <RZN1_HCLK_RSV_ID>;
		clocks = <&clk_48>;
	};
	hclk_rtc: hclk_rtc@RZN1_HCLK_RTC_ID {
		#clock-cells = <0>;
		compatible = "renesas,rzn1-clock-gate";
		reg = <RZN1_HCLK_RTC_ID>;
		clocks = <&clk_ref_sync_d8>;
	};
	hclk_sdio0: hclk_sdio0@RZN1_HCLK_SDIO0_ID {
		#clock-cells = <0>;
		compatible = "renesas,rzn1-clock-gate";
		reg = <RZN1_HCLK_SDIO0_ID>;
		clocks = <&clk_ref_sync_d4>;
	};
	hclk_sdio1: hclk_sdio1@RZN1_HCLK_SDIO1_ID {
		#clock-cells = <0>;
		compatible = "renesas,rzn1-clock-gate";
		reg = <RZN1_HCLK_SDIO1_ID>;
		clocks = <&clk_ref_sync_d4>;
	};
	hclk_semap: hclk_semap@RZN1_HCLK_SEMAP_ID {
		#clock-cells = <0>;
		compatible = "renesas,rzn1-clock-gate";
		reg = <RZN1_HCLK_SEMAP_ID>;
		clocks = <&clk_ref_sync_d4>;
	};
	hclk_sercos: hclk_sercos@RZN1_HCLK_SERCOS_ID {
		#clock-cells = <0>;
		compatible = "renesas,rzn1-clock-gate";
		reg = <RZN1_HCLK_SERCOS_ID>;
		clocks = <&clkout_d10>;
	};
	hclk_sgpio0: hclk_sgpio0@RZN1_HCLK_SGPIO0_ID {
		#clock-cells = <0>;
		compatible = "renesas,rzn1-clock-gate";
		reg = <RZN1_HCLK_SGPIO0_ID>;
		clocks = <&div_motor>;
	};
	hclk_sgpio1: hclk_sgpio1@RZN1_HCLK_SGPIO1_ID {
		#clock-cells = <0>;
		compatible = "renesas,rzn1-clock-gate";
		reg = <RZN1_HCLK_SGPIO1_ID>;
		clocks = <&div_motor>;
	};
	hclk_sgpio2: hclk_sgpio2@RZN1_HCLK_SGPIO2_ID {
		#clock-cells = <0>;
		compatible = "renesas,rzn1-clock-gate";
		reg = <RZN1_HCLK_SGPIO2_ID>;
		clocks = <&div_p5_pg>;
	};
	hclk_sgpio3: hclk_sgpio3@RZN1_HCLK_SGPIO3_ID {
		#clock-cells = <0>;
		compatible = "renesas,rzn1-clock-gate";
		reg = <RZN1_HCLK_SGPIO3_ID>;
		clocks = <&div_p5_pg>;
	};
	hclk_sgpio4: hclk_sgpio4@RZN1_HCLK_SGPIO4_ID {
		#clock-cells = <0>;
		compatible = "renesas,rzn1-clock-gate";
		reg = <RZN1_HCLK_SGPIO4_ID>;
		clocks = <&div_p5_pg>;
	};
	hclk_spi0: hclk_spi0@RZN1_HCLK_SPI0_ID {
		#clock-cells = <0>;
		compatible = "renesas,rzn1-clock-gate";
		reg = <RZN1_HCLK_SPI0_ID>;
		clocks = <&clk_ref_sync_d4>;
	};
	hclk_spi1: hclk_spi1@RZN1_HCLK_SPI1_ID {
		#clock-cells = <0>;
		compatible = "renesas,rzn1-clock-gate";
		reg = <RZN1_HCLK_SPI1_ID>;
		clocks = <&clk_ref_sync_d4>;
	};
	hclk_spi2: hclk_spi2@RZN1_HCLK_SPI2_ID {
		#clock-cells = <0>;
		compatible = "renesas,rzn1-clock-gate";
		reg = <RZN1_HCLK_SPI2_ID>;
		clocks = <&clk_ref_sync_d4>;
	};
	hclk_spi3: hclk_spi3@RZN1_HCLK_SPI3_ID {
		#clock-cells = <0>;
		compatible = "renesas,rzn1-clock-gate";
		reg = <RZN1_HCLK_SPI3_ID>;
		clocks = <&clk_ref_sync_d4>;
	};
	hclk_spi4: hclk_spi4@RZN1_HCLK_SPI4_ID {
		#clock-cells = <0>;
		compatible = "renesas,rzn1-clock-gate";
		reg = <RZN1_HCLK_SPI4_ID>;
		clocks = <&clk_ref_sync_d4>;
	};
	hclk_spi5: hclk_spi5@RZN1_HCLK_SPI5_ID {
		#clock-cells = <0>;
		compatible = "renesas,rzn1-clock-gate";
		reg = <RZN1_HCLK_SPI5_ID>;
		clocks = <&clk_ref_sync_d4>;
	};
	hclk_switch: hclk_switch@RZN1_HCLK_SWITCH_ID {
		#clock-cells = <0>;
		compatible = "renesas,rzn1-clock-gate";
		reg = <RZN1_HCLK_SWITCH_ID>;
		clocks = <&clk_ref_sync_d4>;
	};
	hclk_switch_rg: hclk_switch_rg@RZN1_HCLK_SWITCH_RG_ID {
		#clock-cells = <0>;
		compatible = "renesas,rzn1-clock-gate";
		reg = <RZN1_HCLK_SWITCH_RG_ID>;
		clocks = <&clk_ref_sync_d4>;
	};
	hclk_timer0: hclk_timer0@RZN1_HCLK_TIMER0_ID {
		#clock-cells = <0>;
		compatible = "renesas,rzn1-clock-gate";
		reg = <RZN1_HCLK_TIMER0_ID>;
		clocks = <&clkout_d40>;
	};
	hclk_timer1: hclk_timer1@RZN1_HCLK_TIMER1_ID {
		#clock-cells = <0>;
		compatible = "renesas,rzn1-clock-gate";
		reg = <RZN1_HCLK_TIMER1_ID>;
		clocks = <&clkout_d40>;
	};
	hclk_uart0: hclk_uart0@RZN1_HCLK_UART0_ID {
		#clock-cells = <0>;
		compatible = "renesas,rzn1-clock-gate";
		reg = <RZN1_HCLK_UART0_ID>;
		clocks = <&clk_ref_sync_d8>;
	};
	hclk_uart1: hclk_uart1@RZN1_HCLK_UART1_ID {
		#clock-cells = <0>;
		compatible = "renesas,rzn1-clock-gate";
		reg = <RZN1_HCLK_UART1_ID>;
		clocks = <&clk_ref_sync_d8>;
	};
	hclk_uart2: hclk_uart2@RZN1_HCLK_UART2_ID {
		#clock-cells = <0>;
		compatible = "renesas,rzn1-clock-gate";
		reg = <RZN1_HCLK_UART2_ID>;
		clocks = <&clk_ref_sync_d8>;
	};
	hclk_uart3: hclk_uart3@RZN1_HCLK_UART3_ID {
		#clock-cells = <0>;
		compatible = "renesas,rzn1-clock-gate";
		reg = <RZN1_HCLK_UART3_ID>;
		clocks = <&clk_ref_sync_d4>;
	};
	hclk_uart4: hclk_uart4@RZN1_HCLK_UART4_ID {
		#clock-cells = <0>;
		compatible = "renesas,rzn1-clock-gate";
		reg = <RZN1_HCLK_UART4_ID>;
		clocks = <&clk_ref_sync_d4>;
	};
	hclk_uart5: hclk_uart5@RZN1_HCLK_UART5_ID {
		#clock-cells = <0>;
		compatible = "renesas,rzn1-clock-gate";
		reg = <RZN1_HCLK_UART5_ID>;
		clocks = <&clk_ref_sync_d4>;
	};
	hclk_uart6: hclk_uart6@RZN1_HCLK_UART6_ID {
		#clock-cells = <0>;
		compatible = "renesas,rzn1-clock-gate";
		reg = <RZN1_HCLK_UART6_ID>;
		clocks = <&clk_ref_sync_d4>;
	};
	hclk_uart7: hclk_uart7@RZN1_HCLK_UART7_ID {
		#clock-cells = <0>;
		compatible = "renesas,rzn1-clock-gate";
		reg = <RZN1_HCLK_UART7_ID>;
		clocks = <&clk_ref_sync_d4>;
	};
	hclk_usbf: hclk_usbf@RZN1_HCLK_USBF_ID {
		#clock-cells = <0>;
		compatible = "renesas,rzn1-clock-gate";
		reg = <RZN1_HCLK_USBF_ID>;
		clocks = <&clkout_d8>;
	};
	hclk_usbh: hclk_usbh@RZN1_HCLK_USBH_ID {
		#clock-cells = <0>;
		compatible = "renesas,rzn1-clock-gate";
		reg = <RZN1_HCLK_USBH_ID>;
		clocks = <&clkout_d8>;
	};
	hclk_usbpm: hclk_usbpm@RZN1_HCLK_USBPM_ID {
		#clock-cells = <0>;
		compatible = "renesas,rzn1-clock-gate";
		reg = <RZN1_HCLK_USBPM_ID>;
		clocks = <&clkout_d8>;
	};
	rtos_mdc: rtos_mdc@RZN1_SYSCTRL_REG_PWRCTRL_HWRTOS_MDCDIV {
		#clock-cells = <0>;
		compatible = "renesas,rzn1-clock-divider";
		renesas,rzn1-bit-mask = <0x3ff>;
		renesas,rzn1-div-min = <80>;
		renesas,rzn1-div-max = <640>;
		reg = <RZN1_SYSCTRL_REG_PWRCTRL_HWRTOS_MDCDIV>;
		renesas,rzn1-div-table = <80 160 320 640>;
		clocks = <&clk_ref_sync>;
	};
};
